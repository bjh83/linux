## Documentation/devicetree/bindings/ipmi/ipmi-bt-i2c.txt
```
Device tree configuration for the ipmi-bt-i2c driver.

Required Properties:
- compatible 	: should be "ipmi-bt-i2c"
- reg		: the I2C slave address of the ipmi-bmc-bt-i2c

i2c0: i2c-bus@40 {
	#address-cells = <1>;
	#size-cells = <0>;
	reg = <0x40 0x40>;
	compatible = "aspeed,ast2400-i2c-bus";
	clock-frequency = <100000>;
	status = "disabled";
	interrupts = <0>;
	interrupt-parent = <&i2c>;

	bt-i2c-master@41 {
		compatible = "ipmi-bt-i2c";
		reg = <0x41>;
	};
};
```

## Documentation/devicetree/bindings/ipmi_bmc/ipmi-bmc-bt-i2c.txt
```
Device tree configuration for the ipmi-bmc-bt-i2c driver.

Required Properties:
- compatible 	: should be "ipmi-bmc-bt-i2c"
- reg		: the I2C slave address of this driver.

i2c0: i2c-bus@40 {
	#address-cells = <1>;
	#size-cells = <0>;
	reg = <0x40 0x40>;
	compatible = "aspeed,ast2400-i2c-bus";
	clock-frequency = <100000>;
	status = "disabled";
	interrupts = <0>;
	interrupt-parent = <&i2c>;

	bt-i2c-slave@41 {
		compatible = "ipmi-bmc-bt-i2c";
		reg = <0x41>;
	};
};
```

## drivers/char/ipmi_bmc/Kconfig
```kconfig
#
# IPMI BMC configuration
#

menuconfig IPMI_BMC
	tristate 'IPMI BMC core'
	help
	  This enables the BMC-side IPMI drivers.

	  If unsure, say N.

if IPMI_BMC

config IPMI_BMC_BT_I2C
	depends on I2C
	select I2C_SLAVE
	tristate 'Generic I2C BT IPMI BMC driver'
	help
	  Provides a driver that uses IPMI Block Transfer messages and
	  semantics on top of plain old I2C.

config ASPEED_BT_IPMI_BMC
	depends on ARCH_ASPEED || COMPILE_TEST
	depends on REGMAP && REGMAP_MMIO && MFD_SYSCON
	tristate "BT IPMI bmc driver"
	help
	  Provides a driver for the BT (Block Transfer) IPMI interface
	  found on Aspeed SOCs (AST2400 and AST2500). The driver
	  implements the BMC side of the BT interface.

endif # IPMI_BMC
```

## test/Kconfig
```kconfig
config TEST
	bool
	default y

config EXAMPLE_TEST
	bool
	depends on TEST
	default y
```
